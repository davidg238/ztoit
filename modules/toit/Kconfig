## modules/toit/Kconfig
```kconfig
config TOIT
	bool "Toit VM core"
	depends on CPP
	select PSA_CRYPTO
	select MBEDTLS
	select PSA_WANT_ALG_SHA_256
	select PSA_WANT_ALG_SHA_512
	select PSA_WANT_ALG_ECDSA
	select PSA_WANT_ECC_SECP_R1_256
	select PSA_WANT_KEY_TYPE_ECC_PUBLIC_KEY
	select PSA_WANT_KEY_TYPE_ECC_KEY_PAIR_GENERATE
	help
	  Compile the Toit VM core from $TOIT_SRC (see ztoit's env.sh).
	  The PSA_WANT selects pick the Mbed TLS 4 legacy modules the VM links
	  (bignum, SHA-256/512, entropy; ECDSA and P-256 are the only route to
	  bignum). They are selects, not conf lines, because OpenThread's default
	  security config makes those symbols promptless, and a conf line is then
	  ignored (ztoit #47).

config TOIT_CRYPTO
	bool "The VM's crypto primitives: SHA-1/2, AES, AES-GCM, ChaCha20-Poly1305"
	depends on TOIT
	select PSA_WANT_ALG_SHA_224
	select PSA_WANT_ALG_SHA_384
	select PSA_WANT_KEY_TYPE_AES
	select PSA_WANT_ALG_ECB_NO_PADDING
	select PSA_WANT_ALG_CBC_NO_PADDING
	select PSA_WANT_ALG_GCM
	select PSA_WANT_KEY_TYPE_CHACHA20
	select PSA_WANT_ALG_CHACHA20_POLY1305
	help
	  Compiles primitive_crypto.cc (Toit's `crypto` module 15). Off on
	  the boards for flash. RSA and EC keys answer UNIMPLEMENTED on
	  Mbed TLS 4, and tls and x509 are not built on the port (ztoit#61).

config TOIT_CRYPTO_EXTRA
	bool "Blake2s and SipHash (the VM's own code, no Mbed TLS)"
	depends on TOIT_CRYPTO
	help
	  As the ESP32 build's knob of the same name.

config ZVFS_EVENTFD_ADD_SIZE_TOIT
	int "eventfds the VM's socket event source needs"
	default 1
	depends on TOIT && ZVFS_EVENTFD
	help
	  The zsock event source wakes its poll loop with one eventfd. Zephyr
	  sums the ZVFS_EVENTFD_ADD_SIZE_* symbols into ZVFS_EVENTFD_MAX; from
	  4.5 the CoAP client (the agent) claims one too, so without this the
	  source finds none and aborts at boot (ztoit #47).

config TOIT_HEAP_SIZE
	int "Bytes in the static arena Toit heap pages come from"
	default 163840
	depends on TOIT

config TOIT_RAM_REGISTRY_SIZE
	int "Bytes in the RAM flash registry (boards without a toit_partition)"
	default 131072
	depends on TOIT
	help
	  Without a toit_partition the registry is a static RAM array that
	  holds every installed program. The QEMU test runs (tests/qemu) hold
	  hundreds of test programs.

config TOIT_HEAP_NOINIT
	bool "Put the arena in .noinit"
	depends on TOIT
	help
	  On the ESP32 with ESP32_REGION_1_NOINIT this moves the arena to the
	  second DRAM bank, leaving the first to the C heap.

config TOIT_LINK_IP
	bool "net.open takes the IP interface Zephyr brings up itself"
	depends on TOIT && NET_SOCKETS && !NET_L2_OPENTHREAD && !WIFI
	help
	  Loopback or Ethernet with a static address (NET_CONFIG_SETTINGS),
	  as in the QEMU test runs (ztoit#61): net.open and close leave the
	  interface alone. Without a link in the build net.open throws.

config TOIT_THREAD_DOWN_DETACH
	bool "Thread down = disabled"
	depends on NET_L2_OPENTHREAD
	help
	  Down = Thread disabled (each net.open rejoins); default: stay attached
	  as a sleepy end device (ztoit design §7).

config TOIT_AGENT
	bool "The C agent: check in with porta over CoAP (rete #521)"
	depends on NETWORKING && (NET_IPV4 || NET_IPV6)
	depends on SETTINGS
	select COAP_CLIENT
	select ZCBOR
	select ZCBOR_CANONICAL
	select MBEDTLS
	select PSA_WANT_ALG_SHA_256
	select REBOOT
	help
	  On each net.open that brings the link up (WiFi: the IPv4 lease;
	  Thread: thread_up) pull the node's batch from porta and push
	  obs/build; install goal/apps images (nodus-toit design §5, addendum
	  2026-11-17). Its records need SETTINGS, which each link's conf
	  already enables (WiFi credentials, the OpenThread dataset).

config TOIT_AGENT_PORTA
	string "porta's CoAP address (a literal of the build's family)"
	depends on TOIT_AGENT
	help
	  IPv6 when the build has it (Thread), else IPv4 (WiFi), as the VM's
	  sockets. Deployment-specific: set it in the link's git-ignored
	  prj_*.local.conf.

config TOIT_AGENT_PORT
	int "porta's CoAP port"
	default 5683
	depends on TOIT_AGENT

config TOIT_AGENT_PUBKEY
	string "porta's ed25519 public key (64 hex digits, porta's pub key file)"
	default ""
	depends on TOIT_AGENT
	help
	  Images are installed only if signed by this key. Deployment-specific:
	  set it in the git-ignored local conf. Empty: nothing installs, and the
	  agent says so on the console.

config TOIT_AGENT_STACK_SIZE
	int "Agent thread stack"
	default 5120
	depends on TOIT_AGENT
	help
	  The ed25519 check is the deepest path: about 4.1 KB on the ESP32
	  (gcc -fstack-usage, 2026-11-17: ed25519_verify 2352 + add 1200 +
	  M 304 + the agent's frames), where a check-in needed 3072.
```

## modules/toit/dts/bindings/misc/ztoit,buses.yaml
```yaml
# Copyright (C) 2026 Toit contributors.
# SPDX-License-Identifier: Apache-2.0
compatible: "ztoit,buses"
description: |
  The bus controllers Toit's standard libraries may open, each by the pin
  numbers its pinctrl routes (ztoit#62; docs/design/zephyr-port.md, addendum
  2026-11-27). One child per controller. Pin numbers are Toit's, 32 x port +
  pin, as in toit,platform. A child's kind is the pins it names: sda and scl
  make it I2C. Toit's i2c.Bus opens the child whose sda and scl are the pins
  it is given. Pins are not re-routed: these properties must match the
  controller's pinctrl.
include: base.yaml
child-binding:
  description: One controller and the Toit pin numbers its pinctrl routes.
  properties:
    controller:
      type: phandle
      required: true
      description: The bus controller.
    sda:
      type: int
      description: I2C data pin.
    scl:
      type: int
      description: I2C clock pin.
```
